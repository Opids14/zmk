#include <dt-bindings/zmk/matrix_transform.h>

&{/} {
    kscan: kscan {
        compatible = "zmk,kscan-gpio";
        diode-direction = "col2row";
        rows = <3>;
        cols = <6>;
        matrix-transform = &matrix_transform_6x3;

        row-gpios = <&gpio0 14 (GPIO_ACTIVE_HIGH | GPIO_PULL_DOWN)>,
                    <&gpio0 16 (GPIO_ACTIVE_HIGH | GPIO_PULL_DOWN)>,
                    <&gpio0 10 (GPIO_ACTIVE_HIGH | GPIO_PULL_DOWN)>;

        col-gpios = <&gpio0 4 GPIO_ACTIVE_HIGH>,
                    <&gpio0 5 GPIO_ACTIVE_HIGH>,
                    <&gpio0 6 GPIO_ACTIVE_HIGH>,
                    <&gpio0 7 GPIO_ACTIVE_HIGH>,
                    <&gpio0 8 GPIO_ACTIVE_HIGH>,
                    <&gpio0 9 GPIO_ACTIVE_HIGH>;
    };

    key_physical_attrs: key_physical_attrs {
        compatible = "zmk,key-physical-attrs";
    };

    key-positions {
        compatible = "zmk,key-positions";
        label = "physical-layout";

        positions = <
            /* Row 0 */
            &key_physical_attrs 100 100 0   0 0 0 0
            &key_physical_attrs 100 100 100 0 0 0 0
            &key_physical_attrs 100 100 200 0 0 0 0
            &key_physical_attrs 100 100 300 0 0 0 0
            &key_physical_attrs 100 100 400 0 0 0 0
            &key_physical_attrs 100 100 500 0 0 0 0

            /* Row 1 */
            &key_physical_attrs 100 100 0   100 0 0 0
            &key_physical_attrs 100 100 100 100 0 0 0
            &key_physical_attrs 100 100 200 100 0 0 0
            &key_physical_attrs 100 100 300 100 0 0 0
            &key_physical_attrs 100 100 400 100 0 0 0
            &key_physical_attrs 100 100 500 100 0 0 0

            /* Row 2 */
            &key_physical_attrs 100 100 0   200 0 0 0
            &key_physical_attrs 100 100 100 200 0 0 0
            &key_physical_attrs 100 100 200 200 0 0 0
            &key_physical_attrs 100 100 300 200 0 0 0
            &key_physical_attrs 100 100 400 200 0 0 0
            &key_physical_attrs 100 100 500 200 0 0 0
        >;
    };
};